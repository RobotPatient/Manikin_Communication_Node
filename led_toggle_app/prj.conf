## CMakeLists.txt
```
# SPDX-License-Identifier: Apache-2.0

cmake_minimum_required(VERSION 3.20.0)
find_package(Zephyr REQUIRED HINTS $ENV{ZEPHYR_BASE})
project(led_toggle_app)

target_sources(app PRIVATE src/main.c)
target_sources(app PRIVATE src/led_service.c)
```

## prj.conf
```kconfig
# Generic Bluetooth configuration
CONFIG_BT=y
CONFIG_BT_PERIPHERAL=y
CONFIG_BT_DEVICE_NAME="LED Toggle"
CONFIG_BT_DEVICE_APPEARANCE=0
CONFIG_BT_MAX_CONN=1
CONFIG_BT_LE_ADVERTISING=y

# GATT Services
CONFIG_BT_GATT_DYNAMIC_DB=y

# Logging
CONFIG_LOG=y
CONFIG_LOG_DEFAULT_LEVEL=3

# GPIO for LED
CONFIG_GPIO=y

# Enable DTB aliases
CONFIG_DEVICE_DT_ALIAS=y
```

## src/main.c
```c
/* main.c - LED Toggle BLE Application main entry point */

#include <zephyr/kernel.h>
#include <zephyr/logging/log.h>
#include <zephyr/bluetooth/bluetooth.h>
#include <zephyr/bluetooth/hci.h>
#include <zephyr/bluetooth/conn.h>
#include <zephyr/bluetooth/uuid.h>
#include <zephyr/bluetooth/gatt.h>
#include "led_service.h"

LOG_MODULE_REGISTER(main, LOG_LEVEL_INF);

#define DEVICE_NAME CONFIG_BT_DEVICE_NAME
#define DEVICE_NAME_LEN (sizeof(DEVICE_NAME) - 1)

/* BLE connection handle */
static struct bt_conn *current_conn;

/* Advertising data */
static const struct bt_data ad[] = {
    BT_DATA_BYTES(BT_DATA_FLAGS, (BT_LE_AD_GENERAL | BT_LE_AD_NO_BREDR)),
    BT_DATA(BT_DATA_NAME_COMPLETE, DEVICE_NAME, DEVICE_NAME_LEN),
};

/* BT connection callbacks */
static void connected(struct bt_conn *conn, uint8_t err)
{
    if (err) {
        LOG_ERR("Connection failed (err %u)", err);
        return;
    }

    LOG_INF("Connected");
    current_conn = bt_conn_ref(conn);
}

static void disconnected(struct bt_conn *conn, uint8_t reason)
{
    LOG_INF("Disconnected (reason %u)", reason);

    if (current_conn) {
        bt_conn_unref(current_conn);
        current_conn = NULL;
    }
}

BT_CONN_CB_DEFINE(conn_callbacks) = {
    .connected = connected,
    .disconnected = disconnected,
};

/* BT ready callback - called when Bluetooth is initialized */
static void bt_ready(int err)
{
    if (err) {
        LOG_ERR("Bluetooth init failed (err %d)", err);
        return;
    }

    LOG_INF("Bluetooth initialized");

    /* Initialize the LED service */
    led_service_init();

    /* Start advertising */
    err = bt_le_adv_start(BT_LE_ADV_CONN, ad, ARRAY_SIZE(ad), NULL, 0);
    if (err) {
        LOG_ERR("Advertising failed to start (err %d)", err);
        return;
    }

    LOG_INF("Advertising started");
}

int main(void)
{
    int err;

    LOG_INF("Starting LED Toggle BLE Application");

    /* Initialize the LED hardware */
    err = led_init();
    if (err) {
        LOG_ERR("LED initialization failed (err %d)", err);
        return 0;
    }

    /* Initialize Bluetooth subsystem */
    err = bt_enable(bt_ready);
    if (err) {
        LOG_ERR("Bluetooth init failed (err %d)", err);
        return 0;
    }

    return 0;
}
```

## src/led_service.c
```c
/* led_service.c - LED BLE Service */

#include "led_service.h"

#include <zephyr/kernel.h>
#include <zephyr/drivers/gpio.h>
#include <zephyr/logging/log.h>
#include <zephyr/bluetooth/bluetooth.h>
#include <zephyr/bluetooth/hci.h>
#include <zephyr/bluetooth/conn.h>
#include <zephyr/bluetooth/uuid.h>
#include <zephyr/bluetooth/gatt.h>

LOG_MODULE_REGISTER(led_service, LOG_LEVEL_INF);

/* LED hardware configuration */
static const struct gpio_dt_spec led = GPIO_DT_SPEC_GET(DT_ALIAS(led0), gpios);
static bool led_state;

/* LED Service UUIDs */
#define BT_UUID_LED_SERVICE_VAL \
    BT_UUID_128_ENCODE(0x12345678, 0x1234, 0x5678, 0x1234, 0x56789abcdef0)

#define BT_UUID_LED_TOGGLE_CHARACTERISTIC_VAL \
    BT_UUID_128_ENCODE(0x12345678, 0x1234, 0x5678, 0x1234, 0x56789abcdef1)

static struct bt_uuid_128 led_service_uuid = BT_UUID_INIT_128(BT_UUID_LED_SERVICE_VAL);
static struct bt_uuid_128 led_toggle_char_uuid = BT_UUID_INIT_128(BT_UUID_LED_TOGGLE_CHARACTERISTIC_VAL);

/* LED state - for BLE notifications */
static uint8_t led_toggle_value;

/* Write callback for the LED toggle characteristic */
static ssize_t write_led_toggle(struct bt_conn *conn,
                               const struct bt_gatt_attr *attr,
                               const void *buf,
                               uint16_t len, uint16_t offset, uint8_t flags)
{
    /* Toggle the LED regardless of the value written */
    led_toggle();
    
    /* Return the number of bytes written */
    return len;
}

/* LED service definition */
BT_GATT_SERVICE_DEFINE(led_svc,
    BT_GATT_PRIMARY_SERVICE(&led_service_uuid),
    BT_GATT_CHARACTERISTIC(&led_toggle_char_uuid.uuid,
                          BT_GATT_CHRC_WRITE | BT_GATT_CHRC_WRITE_WITHOUT_RESP,
                          BT_GATT_PERM_WRITE,
                          NULL, write_led_toggle, &led_toggle_value),
);

/* Public functions */

int led_init(void)
{
    int ret;

    if (!gpio_is_ready_dt(&led)) {
        LOG_ERR("LED GPIO device not ready");
        return -ENODEV;
    }

    ret = gpio_pin_configure_dt(&led, GPIO_OUTPUT_INACTIVE);
    if (ret < 0) {
        LOG_ERR("Error %d: failed to configure LED GPIO", ret);
        return ret;
    }

    led_state = false; /* Initial state is off */
    LOG_INF("LED initialized");
    return 0;
}

void led_toggle(void)
{
    led_state = !led_state;
    gpio_pin_set_dt(&led, led_state);
    LOG_INF("LED %s", led_state ? "ON" : "OFF");
}

void led_service_init(void)
{
    LOG_INF("LED service initialized");
}
```

## src/led_service.h
```c
/* led_service.h - LED BLE Service */

#ifndef LED_SERVICE_H_
#define LED_SERVICE_H_

#include <zephyr/kernel.h>
#include <zephyr/drivers/gpio.h>

#ifdef __cplusplus
extern "C" {
#endif

/* Function to initialize the LED hardware */
int led_init(void);

/* Function to toggle the LED state */
void led_toggle(void);

/* Function to initialize the LED BLE service */
void led_service_init(void);

#ifdef __cplusplus
}
#endif

#endif /* LED_SERVICE_H_ */
```
