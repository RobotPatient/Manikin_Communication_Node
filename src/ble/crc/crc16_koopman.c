/**
 * @file crc16_koopman.c
 * @brief CRC-16 implementation using Koopman polynomial (0x8D95)
 */
#include "crc16_koopman.h"
#include <zephyr/logging/log.h>

LOG_MODULE_REGISTER(crc16_koopman, LOG_LEVEL_INF);

/* Koopman polynomial: 0x8D95 (0x9EB2 with reversed bits) */
#define CRC16_KOOPMAN_POLY 0x8D95

/* Precomputed CRC-16 lookup table for faster calculation */
static const uint16_t crc16_koopman_table[256] = {
    0x0000, 0x8D95, 0x9EB2, 0x1327, 0xAD45, 0x20D0, 0x33F7, 0xBE62,
    0xC9CE, 0x445B, 0x577C, 0xDAE9, 0x648B, 0xE91E, 0xFA39, 0x77AC,
    0x5275, 0xDFE0, 0xCCC7, 0x4152, 0xFF30, 0x72A5, 0x6182, 0xEC17,
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    0xA51B, 0x288E, 0x3BA9, 0xB63C, 0x085E, 0x85CB, 0x96EC, 0x1B79
};

/**
 * @brief Calculate CRC-16 using Koopman polynomial 0x8D95
 * 
 * @param data Pointer to the data buffer
 * @param length Length of the data buffer in bytes
 * @return Calculated CRC-16 value
 */
uint16_t crc16_koopman(const uint8_t *data, size_t length) {
    /* Start with initial CRC value of 0 */
    return crc16_koopman_update(0, data, length);
}

/**
 * @brief Update an existing CRC-16 with new data
 * 
 * This function uses a table-based approach for faster CRC calculation.
 * 
 * @param crc Initial CRC value (use 0 for first call)
 * @param data Pointer to the data buffer
 * @param length Length of the data buffer in bytes
 * @return Updated CRC-16 value
 */
uint16_t crc16_koopman_update(uint16_t crc, const uint8_t *data, size_t length) {
    size_t i;
    
    /* Validate input parameters */
    if (data == NULL && length > 0) {
        LOG_ERR("Invalid input: NULL data pointer with non-zero length");
        return crc;
    }

    /* Calculate CRC for each byte using table lookup */
    for (i = 0; i < length; i++) {
        crc = (crc << 8) ^ crc16_koopman_table[(crc >> 8) ^ data[i]];
    }

    return crc;
}

/* Non-table implementation for reference */
uint16_t crc16_koopman_bit_by_bit(const uint8_t *data, size_t length) {
    uint16_t crc = 0;
    size_t i, j;

    for (i = 0; i < length; i++) {
        crc ^= (data[i] << 8);
        for (j = 0; j < 8; j++) {
            if (crc & 0x8000) {
                crc = (crc << 1) ^ CRC16_KOOPMAN_POLY;
            } else {
                crc = crc << 1;
            }
        }
    }
    
    return crc;
}