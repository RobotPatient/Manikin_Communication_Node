/**
 * Copyright (c) 2024 Rahul Arasikere <arasikere.rahul@gmail.com>.
 *
 * SPDX-License-Identifier: Apache-2.0
 */

&gpioh {
    status = "okay";
};

&rcc {
    //rtcsel = <STM32_RCC_RTCSEL_LSE>;
};

&clk_lse {
    status = "okay";
    clock-frequency = <32768>;
};

&rtc {
    status = "okay";
};
